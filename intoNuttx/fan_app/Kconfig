## runners/pico/pico_wamr/build/Kconfig/soc/Kconfig.tmp
```kconfig
# Load Zephyr SoC Kconfig descriptions.
osource "/home/bruno/.pico-sdk/zephyr_workspace/zephyr-main/soc/xlnx/zynqmp/Kconfig"
osource "/home/bruno/.pico-sdk/zephyr_workspace/zephyr-main/soc/xlnx/zynq7000/Kconfig"
osource "/home/bruno/.pico-sdk/zephyr_workspace/zephyr-main/soc/xlnx/versalnet/Kconfig"
osource "/home/bruno/.pico-sdk/zephyr_workspace/zephyr-main/soc/xlnx/versal2/Kconfig"
osource "/home/bruno/.pico-sdk/zephyr_workspace/zephyr-main/soc/xlnx/versal/Kconfig"
osource "/home/bruno/.pico-sdk/zephyr_workspace/zephyr-main/soc/xen/Kconfig"
osource "/home/bruno/.pico-sdk/zephyr_workspace/zephyr-main/soc/wch/ch32v/Kconfig"
osource "/home/bruno/.pico-sdk/zephyr_workspace/zephyr-main/soc/ti/simplelink/Kconfig"
osource "/home/bruno/.pico-sdk/zephyr_workspace/zephyr-main/soc/ti/mspm0/Kconfig"
osource "/home/bruno/.pico-sdk/zephyr_workspace/zephyr-main/soc/ti/lm3s6965/Kconfig"
osource "/home/bruno/.pico-sdk/zephyr_workspace/zephyr-main/soc/ti/k3/Kconfig"
osource "/home/bruno/.pico-sdk/zephyr_workspace/zephyr-main/soc/telink/tlsr/Kconfig"
osource "/home/bruno/.pico-sdk/zephyr_workspace/zephyr-main/soc/syna/sr100/Kconfig"
osource "/home/bruno/.pico-sdk/zephyr_workspace/zephyr-main/soc/starfive/jh71xx/Kconfig"
osource "/home/bruno/.pico-sdk/zephyr_workspace/zephyr-main/soc/st/stm32/Kconfig"
osource "/home/bruno/.pico-sdk/zephyr_workspace/zephyr-main/soc/snps/qemu_arc/Kconfig"
osource "/home/bruno/.pico-sdk/zephyr_workspace/zephyr-main/soc/snps/nsim/arc_v/Kconfig"
osource "/home/bruno/.pico-sdk/zephyr_workspace/zephyr-main/soc/snps/nsim/arc_classic/Kconfig"
osource "/home/bruno/.pico-sdk/zephyr_workspace/zephyr-main/soc/snps/hsdk4xd/Kconfig"
osource "/home/bruno/.pico-sdk/zephyr_workspace/zephyr-main/soc/snps/hsdk/Kconfig"
osource "/home/bruno/.pico-sdk/zephyr_workspace/zephyr-main/soc/snps/emsk/Kconfig"
osource "/home/bruno/.pico-sdk/zephyr_workspace/zephyr-main/soc/snps/emsdp/Kconfig"
osource "/home/bruno/.pico-sdk/zephyr_workspace/zephyr-main/soc/snps/arc_iot/Kconfig"
osource "/home/bruno/.pico-sdk/zephyr_workspace/zephyr-main/soc/silabs/Kconfig"
osource "/home/bruno/.pico-sdk/zephyr_workspace/zephyr-main/soc/sifli/sf32/Kconfig"
osource "/home/bruno/.pico-sdk/zephyr_workspace/zephyr-main/soc/sifive/sifive_freedom/Kconfig"
osource "/home/bruno/.pico-sdk/zephyr_workspace/zephyr-main/soc/sensry/Kconfig"
osource "/home/bruno/.pico-sdk/zephyr_workspace/zephyr-main/soc/rockchip/Kconfig"
osource "/home/bruno/.pico-sdk/zephyr_workspace/zephyr-main/soc/renode/riscv_virtual/Kconfig"
osource "/home/bruno/.pico-sdk/zephyr_workspace/zephyr-main/soc/renode/cortex_r8_virtual/Kconfig"
osource "/home/bruno/.pico-sdk/zephyr_workspace/zephyr-main/soc/renesas/smartbond/Kconfig"
osource "/home/bruno/.pico-sdk/zephyr_workspace/zephyr-main/soc/renesas/rz/Kconfig"
osource "/home/bruno/.pico-sdk/zephyr_workspace/zephyr-main/soc/renesas/rx/Kconfig"
osource "/home/bruno/.pico-sdk/zephyr_workspace/zephyr-main/soc/renesas/rcar/Kconfig"
osource "/home/bruno/.pico-sdk/zephyr_workspace/zephyr-main/soc/renesas/ra/Kconfig"
osource "/home/bruno/.pico-sdk/zephyr_workspace/zephyr-main/soc/realtek/fingerprint/Kconfig"
osource "/home/bruno/.pico-sdk/zephyr_workspace/zephyr-main/soc/realtek/ec/Kconfig"
osource "/home/bruno/.pico-sdk/zephyr_workspace/zephyr-main/soc/realtek/bee/Kconfig"
osource "/home/bruno/.pico-sdk/zephyr_workspace/zephyr-main/soc/realtek/ameba/Kconfig"
osource "/home/bruno/.pico-sdk/zephyr_workspace/zephyr-main/soc/raspberrypi/rpi_pico/Kconfig"
osource "/home/bruno/.pico-sdk/zephyr_workspace/zephyr-main/soc/quicklogic/eos_s3/Kconfig"
osource "/home/bruno/.pico-sdk/zephyr_workspace/zephyr-main/soc/qemu/virt_riscv/Kconfig"
osource "/home/bruno/.pico-sdk/zephyr_workspace/zephyr-main/soc/qemu/or1k/Kconfig"
osource "/home/bruno/.pico-sdk/zephyr_workspace/zephyr-main/soc/qemu/malta/Kconfig"
osource "/home/bruno/.pico-sdk/zephyr_workspace/zephyr-main/soc/openisa/rv32m1/Kconfig"
osource "/home/bruno/.pico-sdk/zephyr_workspace/zephyr-main/soc/openhwgroup/cva6/Kconfig"
osource "/home/bruno/.pico-sdk/zephyr_workspace/zephyr-main/soc/oct/osd32mp15x/Kconfig"
osource "/home/bruno/.pico-sdk/zephyr_workspace/zephyr-main/soc/nxp/s32/Kconfig"
osource "/home/bruno/.pico-sdk/zephyr_workspace/zephyr-main/soc/nxp/rw/Kconfig"
osource "/home/bruno/.pico-sdk/zephyr_workspace/zephyr-main/soc/nxp/mcx/Kconfig"
osource "/home/bruno/.pico-sdk/zephyr_workspace/zephyr-main/soc/nxp/lpc/Kconfig"
osource "/home/bruno/.pico-sdk/zephyr_workspace/zephyr-main/soc/nxp/layerscape/Kconfig"
osource "/home/bruno/.pico-sdk/zephyr_workspace/zephyr-main/soc/nxp/kinetis/Kconfig"
osource "/home/bruno/.pico-sdk/zephyr_workspace/zephyr-main/soc/nxp/imxrt/Kconfig"
osource "/home/bruno/.pico-sdk/zephyr_workspace/zephyr-main/soc/nxp/imx/Kconfig"
osource "/home/bruno/.pico-sdk/zephyr_workspace/zephyr-main/soc/nuvoton/numicro/Kconfig"
osource "/home/bruno/.pico-sdk/zephyr_workspace/zephyr-main/soc/nuvoton/numaker/Kconfig"
osource "/home/bruno/.pico-sdk/zephyr_workspace/zephyr-main/soc/nuvoton/npcx/Kconfig"
osource "/home/bruno/.pico-sdk/zephyr_workspace/zephyr-main/soc/nuvoton/npcm/Kconfig"
osource "/home/bruno/.pico-sdk/zephyr_workspace/zephyr-main/soc/nordic/Kconfig"
osource "/home/bruno/.pico-sdk/zephyr_workspace/zephyr-main/soc/neorv32/Kconfig"
osource "/home/bruno/.pico-sdk/zephyr_workspace/zephyr-main/soc/native/inf_clock/Kconfig"
osource "/home/bruno/.pico-sdk/zephyr_workspace/zephyr-main/soc/microchip/sam/sama7/Kconfig"
osource "/home/bruno/.pico-sdk/zephyr_workspace/zephyr-main/soc/microchip/sam/sam_d5x_e5x/Kconfig"
osource "/home/bruno/.pico-sdk/zephyr_workspace/zephyr-main/soc/microchip/pic64/Kconfig"
osource "/home/bruno/.pico-sdk/zephyr_workspace/zephyr-main/soc/microchip/pic32c/pic32cz_ca/Kconfig"
osource "/home/bruno/.pico-sdk/zephyr_workspace/zephyr-main/soc/microchip/pic32c/pic32cx_sg/Kconfig"
osource "/home/bruno/.pico-sdk/zephyr_workspace/zephyr-main/soc/microchip/pic32c/pic32cm_pl/Kconfig"
osource "/home/bruno/.pico-sdk/zephyr_workspace/zephyr-main/soc/microchip/pic32c/pic32cm_jh/Kconfig"
osource "/home/bruno/.pico-sdk/zephyr_workspace/zephyr-main/soc/microchip/miv/Kconfig"
osource "/home/bruno/.pico-sdk/zephyr_workspace/zephyr-main/soc/microchip/mec/Kconfig"
osource "/home/bruno/.pico-sdk/zephyr_workspace/zephyr-main/soc/mediatek/mt8xxx/Kconfig"
osource "/home/bruno/.pico-sdk/zephyr_workspace/zephyr-main/soc/lowrisc/opentitan/Kconfig"
osource "/home/bruno/.pico-sdk/zephyr_workspace/zephyr-main/soc/litex/litex_vexriscv/Kconfig"
osource "/home/bruno/.pico-sdk/zephyr_workspace/zephyr-main/soc/ite/ec/Kconfig"
osource "/home/bruno/.pico-sdk/zephyr_workspace/zephyr-main/soc/intel/wildcat_lake/Kconfig"
osource "/home/bruno/.pico-sdk/zephyr_workspace/zephyr-main/soc/intel/raptor_lake/Kconfig"
osource "/home/bruno/.pico-sdk/zephyr_workspace/zephyr-main/soc/intel/panther_lake/Kconfig"
osource "/home/bruno/.pico-sdk/zephyr_workspace/zephyr-main/soc/intel/lakemont/Kconfig"
osource "/home/bruno/.pico-sdk/zephyr_workspace/zephyr-main/soc/intel/intel_socfpga_std/Kconfig"
osource "/home/bruno/.pico-sdk/zephyr_workspace/zephyr-main/soc/intel/intel_socfpga/Kconfig"
osource "/home/bruno/.pico-sdk/zephyr_workspace/zephyr-main/soc/intel/intel_niosv/Kconfig"
osource "/home/bruno/.pico-sdk/zephyr_workspace/zephyr-main/soc/intel/intel_ish/Kconfig"
osource "/home/bruno/.pico-sdk/zephyr_workspace/zephyr-main/soc/intel/intel_adsp/Kconfig"
osource "/home/bruno/.pico-sdk/zephyr_workspace/zephyr-main/soc/intel/elkhart_lake/Kconfig"
osource "/home/bruno/.pico-sdk/zephyr_workspace/zephyr-main/soc/intel/atom/Kconfig"
osource "/home/bruno/.pico-sdk/zephyr_workspace/zephyr-main/soc/intel/apollo_lake/Kconfig"
osource "/home/bruno/.pico-sdk/zephyr_workspace/zephyr-main/soc/intel/alder_lake/Kconfig"
osource "/home/bruno/.pico-sdk/zephyr_workspace/zephyr-main/soc/infineon/psoc4/Kconfig"
osource "/home/bruno/.pico-sdk/zephyr_workspace/zephyr-main/soc/infineon/edge/Kconfig"
osource "/home/bruno/.pico-sdk/zephyr_workspace/zephyr-main/soc/infineon/cat3/Kconfig"
osource "/home/bruno/.pico-sdk/zephyr_workspace/zephyr-main/soc/infineon/cat1c/Kconfig"
osource "/home/bruno/.pico-sdk/zephyr_workspace/zephyr-main/soc/infineon/cat1b/Kconfig"
osource "/home/bruno/.pico-sdk/zephyr_workspace/zephyr-main/soc/infineon/cat1a/Kconfig"
osource "/home/bruno/.pico-sdk/zephyr_workspace/zephyr-main/soc/gd/gd32/Kconfig"
osource "/home/bruno/.pico-sdk/zephyr_workspace/zephyr-main/soc/gaisler/leon3/Kconfig"
osource "/home/bruno/.pico-sdk/zephyr_workspace/zephyr-main/soc/gaisler/gr716a/Kconfig"
osource "/home/bruno/.pico-sdk/zephyr_workspace/zephyr-main/soc/focaltech/Kconfig"
osource "/home/bruno/.pico-sdk/zephyr_workspace/zephyr-main/soc/espressif/Kconfig"
osource "/home/bruno/.pico-sdk/zephyr_workspace/zephyr-main/soc/ene/kb1200/Kconfig"
osource "/home/bruno/.pico-sdk/zephyr_workspace/zephyr-main/soc/ene/kb106x/Kconfig"
osource "/home/bruno/.pico-sdk/zephyr_workspace/zephyr-main/soc/elan/em32f967/Kconfig"
osource "/home/bruno/.pico-sdk/zephyr_workspace/zephyr-main/soc/egis/Kconfig"
osource "/home/bruno/.pico-sdk/zephyr_workspace/zephyr-main/soc/efinix/sapphire/Kconfig"
osource "/home/bruno/.pico-sdk/zephyr_workspace/zephyr-main/soc/cdns/xtensa_sample_controller/Kconfig"
osource "/home/bruno/.pico-sdk/zephyr_workspace/zephyr-main/soc/cdns/swerv/Kconfig"
osource "/home/bruno/.pico-sdk/zephyr_workspace/zephyr-main/soc/cdns/sample_controller32/Kconfig"
osource "/home/bruno/.pico-sdk/zephyr_workspace/zephyr-main/soc/cdns/dc233c/Kconfig"
osource "/home/bruno/.pico-sdk/zephyr_workspace/zephyr-main/soc/brcm/bcmvk/Kconfig"
osource "/home/bruno/.pico-sdk/zephyr_workspace/zephyr-main/soc/brcm/bcm2712/Kconfig"
osource "/home/bruno/.pico-sdk/zephyr_workspace/zephyr-main/soc/brcm/bcm2711/Kconfig"
osource "/home/bruno/.pico-sdk/zephyr_workspace/zephyr-main/soc/blackberry/qnxhv_vm/Kconfig"
osource "/home/bruno/.pico-sdk/zephyr_workspace/zephyr-main/soc/bflb/Kconfig"
osource "/home/bruno/.pico-sdk/zephyr_workspace/zephyr-main/soc/atmel/sam0/Kconfig"
osource "/home/bruno/.pico-sdk/zephyr_workspace/zephyr-main/soc/atmel/sam/Kconfig"
osource "/home/bruno/.pico-sdk/zephyr_workspace/zephyr-main/soc/aspeed/Kconfig"
osource "/home/bruno/.pico-sdk/zephyr_workspace/zephyr-main/soc/arm/Kconfig"
osource "/home/bruno/.pico-sdk/zephyr_workspace/zephyr-main/soc/arm/beetle/Kconfig"
osource "/home/bruno/.pico-sdk/zephyr_workspace/zephyr-main/soc/antmicro/myra/Kconfig"
osource "/home/bruno/.pico-sdk/zephyr_workspace/zephyr-main/soc/andestech/Kconfig"
osource "/home/bruno/.pico-sdk/zephyr_workspace/zephyr-main/soc/amd/acp_6_0/Kconfig"
osource "/home/bruno/.pico-sdk/zephyr_workspace/zephyr-main/soc/ambiq/Kconfig"
osource "/home/bruno/.pico-sdk/zephyr_workspace/zephyr-main/soc/allwinner/sun8i_h3/Kconfig"
osource "/home/bruno/.pico-sdk/zephyr_workspace/zephyr-main/soc/alif/ensemble/Kconfig"
osource "/home/bruno/.pico-sdk/zephyr_workspace/zephyr-main/soc/aesc/Kconfig"
osource "/home/bruno/.pico-sdk/zephyr_workspace/zephyr-main/soc/adi/max32/Kconfig"
```
