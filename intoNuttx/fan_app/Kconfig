## intoNuttx/fan_app/Kconfig
```kconfig
#
# For a description of the syntax of this configuration file,
# see the file kconfig-language.txt in the NuttX tools repository.
#

config CUSTOM_APPS_FAN
    tristate "Fan App"
    default n
    ---help---
        Enable the Fan App

if CUSTOM_APPS_FAN

config CUSTOM_APPS_FAN_PROGNAME
    string "Program name"
    default "fan_app"
    ---help---
        This is the name of the program that will be used when the NSH ELF
        program is installed.

config CUSTOM_APPS_FAN_PRIORITY
    int "Fan App task priority"
    default 100

config CUSTOM_APPS_FAN_STACKSIZE
    int "Fan App stack size"
    default 2048

endif
```

## intoNuttx/led_app/Kconfig
```kconfig
#
# For a description of the syntax of this configuration file,
# see the file kconfig-language.txt in the NuttX tools repository.
#

config CUSTOM_APPS_LED
    tristate "Led App"
    default n
    ---help---
        Enable the Led App (alarm LED driven over UDP)

if CUSTOM_APPS_LED

config CUSTOM_APPS_LED_PROGNAME
    string "Program name"
    default "led_app"
    ---help---
        This is the name of the program that will be used when the NSH ELF
        program is installed.

config CUSTOM_APPS_LED_PRIORITY
    int "Led App task priority"
    default 100

config CUSTOM_APPS_LED_STACKSIZE
    int "Led App stack size"
    default 2048

endif
```

## runners/pico/pico_wamr/build/Kconfig/Kconfig.modules
```kconfig
menu "cmsis_6 (/home/bruno/.pico-sdk/zephyr_workspace/modules/hal/cmsis_6)"
osource "$(ZEPHYR_CMSIS_6_KCONFIG)"
config ZEPHYR_CMSIS_6_MODULE
	bool
	default y
endmenu
menu "hal_infineon (/home/bruno/.pico-sdk/zephyr_workspace/modules/hal/infineon)"
osource "$(ZEPHYR_HAL_INFINEON_KCONFIG)"
config ZEPHYR_HAL_INFINEON_MODULE
	bool
	default y
	select TAINT_BLOBS

config ZEPHYR_HAL_INFINEON_MODULE_BLOBS
	bool
	default y
endmenu
menu "hal_rpi_pico (/home/bruno/.pico-sdk/zephyr_workspace/modules/hal/rpi_pico)"
osource "$(ZEPHYR_HAL_RPI_PICO_KCONFIG)"
config ZEPHYR_HAL_RPI_PICO_MODULE
	bool
	default y
endmenu
menu "segger (/home/bruno/.pico-sdk/zephyr_workspace/modules/debug/segger)"
osource "$(ZEPHYR_SEGGER_KCONFIG)"
config ZEPHYR_SEGGER_MODULE
	bool
	default y
endmenu
```

## runners/pico/pico_wamr/build/Kconfig/Kconfig.sysbuild.modules
```kconfig
config ZEPHYR_CMSIS_6_MODULE
   bool
   default y
config ZEPHYR_HAL_INFINEON_MODULE
   bool
   default y
config ZEPHYR_HAL_RPI_PICO_MODULE
   bool
   default y
config ZEPHYR_SEGGER_MODULE
   bool
   default y
```

## runners/pico/pico_wamr/build/Kconfig/arch/Kconfig
```kconfig
# Load Zephyr Arch Kconfig descriptions.
osource "/home/bruno/.pico-sdk/zephyr_workspace/zephyr-main/arch/rx/Kconfig"
osource "/home/bruno/.pico-sdk/zephyr_workspace/zephyr-main/arch/x86/Kconfig"
osource "/home/bruno/.pico-sdk/zephyr_workspace/zephyr-main/arch/xtensa/Kconfig"
osource "/home/bruno/.pico-sdk/zephyr_workspace/zephyr-main/arch/sparc/Kconfig"
osource "/home/bruno/.pico-sdk/zephyr_workspace/zephyr-main/arch/riscv/Kconfig"
osource "/home/bruno/.pico-sdk/zephyr_workspace/zephyr-main/arch/posix/Kconfig"
osource "/home/bruno/.pico-sdk/zephyr_workspace/zephyr-main/arch/openrisc/Kconfig"
osource "/home/bruno/.pico-sdk/zephyr_workspace/zephyr-main/arch/mips/Kconfig"
osource "/home/bruno/.pico-sdk/zephyr_workspace/zephyr-main/arch/arm64/Kconfig"
osource "/home/bruno/.pico-sdk/zephyr_workspace/zephyr-main/arch/arm/Kconfig"
osource "/home/bruno/.pico-sdk/zephyr_workspace/zephyr-main/arch/arc/Kconfig"
```

## runners/pico/pico_wamr/build/Kconfig/boards/Kconfig.defconfig.tmp
```kconfig
# Load Zephyr board defconfig descriptions.
osource "/home/bruno/.pico-sdk/zephyr_workspace/zephyr-main/boards/raspberrypi/rpi_pico2/Kconfig.defconfig"
```

## runners/pico/pico_wamr/build/Kconfig/boards/Kconfig.rpi_pico2.tmp
```kconfig
# Load board Kconfig descriptions.
osource "/home/bruno/.pico-sdk/zephyr_workspace/zephyr-main/boards/raspberrypi/rpi_pico2/Kconfig.rpi_pico2"
```

## runners/pico/pico_wamr/build/Kconfig/soc/Kconfig.soc.tmp
```kconfig
# Load SoC Kconfig descriptions.
osource "/home/bruno/.pico-sdk/zephyr_workspace/zephyr-main/soc/xlnx/zynqmp/Kconfig.soc"
osource "/home/bruno/.pico-sdk/zephyr_workspace/zephyr-main/soc/xlnx/zynq7000/Kconfig.soc"
osource "/home/bruno/.pico-sdk/zephyr_workspace/zephyr-main/soc/xlnx/versalnet/Kconfig.soc"
osource "/home/bruno/.pico-sdk/zephyr_workspace/zephyr-main/soc/xlnx/versal2/Kconfig.soc"
osource "/home/bruno/.pico-sdk/zephyr_workspace/zephyr-main/soc/xlnx/versal/Kconfig.soc"
osource "/home/bruno/.pico-sdk/zephyr_workspace/zephyr-main/soc/xen/Kconfig.soc"
osource "/home/bruno/.pico-sdk/zephyr_workspace/zephyr-main/soc/wch/ch32v/Kconfig.soc"
osource "/home/bruno/.pico-sdk/zephyr_workspace/zephyr-main/soc/ti/simplelink/Kconfig.soc"
osource "/home/bruno/.pico-sdk/zephyr_workspace/zephyr-main/soc/ti/mspm0/Kconfig.soc"
osource "/home/bruno/.pico-sdk/zephyr_workspace/zephyr-main/soc/ti/lm3s6965/Kconfig.soc"
osource "/home/bruno/.pico-sdk/zephyr_workspace/zephyr-main/soc/ti/k3/Kconfig.soc"
osource "/home/bruno/.pico-sdk/zephyr_workspace/zephyr-main/soc/telink/tlsr/Kconfig.soc"
osource "/home/bruno/.pico-sdk/zephyr_workspace/zephyr-main/soc/syna/sr100/Kconfig.soc"
osource "/home/bruno/.pico-sdk/zephyr_workspace/zephyr-main/soc/starfive/jh71xx/Kconfig.soc"
osource "/home/bruno/.pico-sdk/zephyr_workspace/zephyr-main/soc/st/stm32/Kconfig.soc"
osource "/home/bruno/.pico-sdk/zephyr_workspace/zephyr-main/soc/snps/qemu_arc/Kconfig.soc"
osource "/home/bruno/.pico-sdk/zephyr_workspace/zephyr-main/soc/snps/nsim/arc_v/Kconfig.soc"
osource "/home/bruno/.pico-sdk/zephyr_workspace/zephyr-main/soc/snps/nsim/arc_classic/Kconfig.soc"
osource "/home/bruno/.pico-sdk/zephyr_workspace/zephyr-main/soc/snps/hsdk4xd/Kconfig.soc"
osource "/home/bruno/.pico-sdk/zephyr_workspace/zephyr-main/soc/snps/hsdk/Kconfig.soc"
osource "/home/bruno/.pico-sdk/zephyr_workspace/zephyr-main/soc/snps/emsk/Kconfig.soc"
osource "/home/bruno/.pico-sdk/zephyr_workspace/zephyr-main/soc/snps/emsdp/Kconfig.soc"
osource "/home/bruno/.pico-sdk/zephyr_workspace/zephyr-main/soc/snps/arc_iot/Kconfig.soc"
osource "/home/bruno/.pico-sdk/zephyr_workspace/zephyr-main/soc/silabs/Kconfig.soc"
osource "/home/bruno/.pico-sdk/zephyr_workspace/zephyr-main/soc/sifli/sf32/Kconfig.soc"
osource "/home/bruno/.pico-sdk/zephyr_workspace/zephyr-main/soc/sifive/sifive_freedom/Kconfig.soc"
osource "/home/bruno/.pico-sdk/zephyr_workspace/zephyr-main/soc/sensry/Kconfig.soc"
osource "/home/bruno/.pico-sdk/zephyr_workspace/zephyr-main/soc/rockchip/Kconfig.soc"
osource "/home/bruno/.pico-sdk/zephyr_workspace/zephyr-main/soc/renode/riscv_virtual/Kconfig.soc"
osource "/home/bruno/.pico-sdk/zephyr_workspace/zephyr-main/soc/renode/cortex_r8_virtual/Kconfig.soc"
osource "/home/bruno/.pico-sdk/zephyr_workspace/zephyr-main/soc/renesas/smartbond/Kconfig.soc"
osource "/home/bruno/.pico-sdk/zephyr_workspace/zephyr-main/soc/renesas/rz/Kconfig.soc"
osource "/home/bruno/.pico-sdk/zephyr_workspace/zephyr-main/soc/renesas/rx/Kconfig.soc"
osource "/home/bruno/.pico-sdk/zephyr_workspace/zephyr-main/soc/renesas/rcar/Kconfig.soc"
osource "/home/bruno/.pico-sdk/zephyr_workspace/zephyr-main/soc/renesas/ra/Kconfig.soc"
osource "/home/bruno/.pico-sdk/zephyr_workspace/zephyr-main/soc/realtek/fingerprint/Kconfig.soc"
osource "/home/bruno/.pico-sdk/zephyr_workspace/zephyr-main/soc/realtek/ec/Kconfig.soc"
osource "/home/bruno/.pico-sdk/zephyr_workspace/zephyr-main/soc/realtek/bee/Kconfig.soc"
osource "/home/bruno/.pico-sdk/zephyr_workspace/zephyr-main/soc/realtek/ameba/Kconfig.soc"
osource "/home/bruno/.pico-sdk/zephyr_workspace/zephyr-main/soc/raspberrypi/rpi_pico/Kconfig.soc"
osource "/home/bruno/.pico-sdk/zephyr_workspace/zephyr-main/soc/quicklogic/eos_s3/Kconfig.soc"
osource "/home/bruno/.pico-sdk/zephyr_workspace/zephyr-main/soc/qemu/virt_riscv/Kconfig.soc"
osource "/home/bruno/.pico-sdk/zephyr_workspace/zephyr-main/soc/qemu/or1k/Kconfig.soc"
osource "/home/bruno/.pico-sdk/zephyr_workspace/zephyr-main/soc/qemu/malta/Kconfig.soc"
osource "/home/bruno/.pico-sdk/zephyr_workspace/zephyr-main/soc/openisa/rv32m1/Kconfig.soc"
osource "/home/bruno/.pico-sdk/zephyr_workspace/zephyr-main/soc/openhwgroup/cva6/Kconfig.soc"
osource "/home/bruno/.pico-sdk/zephyr_workspace/zephyr-main/soc/oct/osd32mp15x/Kconfig.soc"
osource "/home/bruno/.pico-sdk/zephyr_workspace/zephyr-main/soc/nxp/s32/Kconfig.soc"
osource "/home/bruno/.pico-sdk/zephyr_workspace/zephyr-main/soc/nxp/rw/Kconfig.soc"
osource "/home/bruno/.pico-sdk/zephyr_workspace/zephyr-main/soc/nxp/mcx/Kconfig.soc"
osource "/home/bruno/.pico-sdk/zephyr_workspace/zephyr-main/soc/nxp/lpc/Kconfig.soc"
osource "/home/bruno/.pico-sdk/zephyr_workspace/zephyr-main/soc/nxp/layerscape/Kconfig.soc"
osource "/home/bruno/.pico-sdk/zephyr_workspace/zephyr-main/soc/nxp/kinetis/Kconfig.soc"
osource "/home/bruno/.pico-sdk/zephyr_workspace/zephyr-main/soc/nxp/imxrt/Kconfig.soc"
osource "/home/bruno/.pico-sdk/zephyr_workspace/zephyr-main/soc/nxp/imx/Kconfig.soc"
osource "/home/bruno/.pico-sdk/zephyr_workspace/zephyr-main/soc/nuvoton/numicro/Kconfig.soc"
osource "/home/bruno/.pico-sdk/zephyr_workspace/zephyr-main/soc/nuvoton/numaker/Kconfig.soc"
osource "/home/bruno/.pico-sdk/zephyr_workspace/zephyr-main/soc/nuvoton/npcx/Kconfig.soc"
osource "/home/bruno/.pico-sdk/zephyr_workspace/zephyr-main/soc/nuvoton/npcm/Kconfig.soc"
osource "/home/bruno/.pico-sdk/zephyr_workspace/zephyr-main/soc/nordic/Kconfig.soc"
osource "/home/bruno/.pico-sdk/zephyr_workspace/zephyr-main/soc/neorv32/Kconfig.soc"
osource "/home/bruno/.pico-sdk/zephyr_workspace/zephyr-main/soc/native/inf_clock/Kconfig.soc"
osource "/home/bruno/.pico-sdk/zephyr_workspace/zephyr-main/soc/microchip/sam/sama7/Kconfig.soc"
osource "/home/bruno/.pico-sdk/zephyr_workspace/zephyr-main/soc/microchip/sam/sam_d5x_e5x/Kconfig.soc"
osource "/home/bruno/.pico-sdk/zephyr_workspace/zephyr-main/soc/microchip/pic64/Kconfig.soc"
osource "/home/bruno/.pico-sdk/zephyr_workspace/zephyr-main/soc/microchip/pic32c/pic32cz_ca/Kconfig.soc"
osource "/home/bruno/.pico-sdk/zephyr_workspace/zephyr-main/soc/microchip/pic32c/pic32cx_sg/Kconfig.soc"
osource "/home/bruno/.pico-sdk/zephyr_workspace/zephyr-main/soc/microchip/pic32c/pic32cm_pl/Kconfig.soc"
osource "/home/bruno/.pico-sdk/zephyr_workspace/zephyr-main/soc/microchip/pic32c/pic32cm_jh/Kconfig.soc"
osource "/home/bruno/.pico-sdk/zephyr_workspace/zephyr-main/soc/microchip/miv/Kconfig.soc"
osource "/home/bruno/.pico-sdk/zephyr_workspace/zephyr-main/soc/microchip/mec/Kconfig.soc"
osource "/home/bruno/.pico-sdk/zephyr_workspace/zephyr-main/soc/mediatek/mt8xxx/Kconfig.soc"
osource "/home/bruno/.pico-sdk/zephyr_workspace/zephyr-main/soc/lowrisc/opentitan/Kconfig.soc"
osource "/home/bruno/.pico-sdk/zephyr_workspace/zephyr-main/soc/litex/litex_vexriscv/Kconfig.soc"
osource "/home/bruno/.pico-sdk/zephyr_workspace/zephyr-main/soc/ite/ec/Kconfig.soc"
osource "/home/bruno/.pico-sdk/zephyr_workspace/zephyr-main/soc/intel/wildcat_lake/Kconfig.soc"
osource "/home/bruno/.pico-sdk/zephyr_workspace/zephyr-main/soc/intel/raptor_lake/Kconfig.soc"
osource "/home/bruno/.pico-sdk/zephyr_workspace/zephyr-main/soc/intel/panther_lake/Kconfig.soc"
osource "/home/bruno/.pico-sdk/zephyr_workspace/zephyr-main/soc/intel/lakemont/Kconfig.soc"
osource "/home/bruno/.pico-sdk/zephyr_workspace/zephyr-main/soc/intel/intel_socfpga_std/Kconfig.soc"
osource "/home/bruno/.pico-sdk/zephyr_workspace/zephyr-main/soc/intel/intel_socfpga/Kconfig.soc"
osource "/home/bruno/.pico-sdk/zephyr_workspace/zephyr-main/soc/intel/intel_niosv/Kconfig.soc"
osource "/home/bruno/.pico-sdk/zephyr_workspace/zephyr-main/soc/intel/intel_ish/Kconfig.soc"
osource "/home/bruno/.pico-sdk/zephyr_workspace/zephyr-main/soc/intel/intel_adsp/Kconfig.soc"
osource "/home/bruno/.pico-sdk/zephyr_workspace/zephyr-main/soc/intel/elkhart_lake/Kconfig.soc"
osource "/home/bruno/.pico-sdk/zephyr_workspace/zephyr-main/soc/intel/atom/Kconfig.soc"
osource "/home/bruno/.pico-sdk/zephyr_workspace/zephyr-main/soc/intel/apollo_lake/Kconfig.soc"
osource "/home/bruno/.pico-sdk/zephyr_workspace/zephyr-main/soc/intel/alder_lake/Kconfig.soc"
osource "/home/bruno/.pico-sdk/zephyr_workspace/zephyr-main/soc/infineon/psoc4/Kconfig.soc"
osource "/home/bruno/.pico-sdk/zephyr_workspace/zephyr-main/soc/infineon/edge/Kconfig.soc"
osource "/home/bruno/.pico-sdk/zephyr_workspace/zephyr-main/soc/infineon/cat3/Kconfig.soc"
osource "/home/bruno/.pico-sdk/zephyr_workspace/zephyr-main/soc/infineon/cat1c/Kconfig.soc"
osource "/home/bruno/.pico-sdk/zephyr_workspace/zephyr-main/soc/infineon/cat1b/Kconfig.soc"
osource "/home/bruno/.pico-sdk/zephyr_workspace/zephyr-main/soc/infineon/cat1a/Kconfig.soc"
osource "/home/bruno/.pico-sdk/zephyr_workspace/zephyr-main/soc/gd/gd32/Kconfig.soc"
osource "/home/bruno/.pico-sdk/zephyr_workspace/zephyr-main/soc/gaisler/leon3/Kconfig.soc"
osource "/home/bruno/.pico-sdk/zephyr_workspace/zephyr-main/soc/gaisler/gr716a/Kconfig.soc"
osource "/home/bruno/.pico-sdk/zephyr_workspace/zephyr-main/soc/focaltech/Kconfig.soc"
osource "/home/bruno/.pico-sdk/zephyr_workspace/zephyr-main/soc/espressif/Kconfig.soc"
osource "/home/bruno/.pico-sdk/zephyr_workspace/zephyr-main/soc/ene/kb1200/Kconfig.soc"
osource "/home/bruno/.pico-sdk/zephyr_workspace/zephyr-main/soc/ene/kb106x/Kconfig.soc"
osource "/home/bruno/.pico-sdk/zephyr_workspace/zephyr-main/soc/elan/em32f967/Kconfig.soc"
osource "/home/bruno/.pico-sdk/zephyr_workspace/zephyr-main/soc/egis/Kconfig.soc"
osource "/home/bruno/.pico-sdk/zephyr_workspace/zephyr-main/soc/efinix/sapphire/Kconfig.soc"
osource "/home/bruno/.pico-sdk/zephyr_workspace/zephyr-main/soc/cdns/xtensa_sample_controller/Kconfig.soc"
osource "/home/bruno/.pico-sdk/zephyr_workspace/zephyr-main/soc/cdns/swerv/Kconfig.soc"
osource "/home/bruno/.pico-sdk/zephyr_workspace/zephyr-main/soc/cdns/sample_controller32/Kconfig.soc"
osource "/home/bruno/.pico-sdk/zephyr_workspace/zephyr-main/soc/cdns/dc233c/Kconfig.soc"
osource "/home/bruno/.pico-sdk/zephyr_workspace/zephyr-main/soc/brcm/bcmvk/Kconfig.soc"
osource "/home/bruno/.pico-sdk/zephyr_workspace/zephyr-main/soc/brcm/bcm2712/Kconfig.soc"
osource "/home/bruno/.pico-sdk/zephyr_workspace/zephyr-main/soc/brcm/bcm2711/Kconfig.soc"
osource "/home/bruno/.pico-sdk/zephyr_workspace/zephyr-main/soc/blackberry/qnxhv_vm/Kconfig.soc"
osource "/home/bruno/.pico-sdk/zephyr_workspace/zephyr-main/soc/bflb/Kconfig.soc"
osource "/home/bruno/.pico-sdk/zephyr_workspace/zephyr-main/soc/atmel/sam0/Kconfig.soc"
osource "/home/bruno/.pico-sdk/zephyr_workspace/zephyr-main/soc/atmel/sam/Kconfig.soc"
osource "/home/bruno/.pico-sdk/zephyr_workspace/zephyr-main/soc/aspeed/Kconfig.soc"
osource "/home/bruno/.pico-sdk/zephyr_workspace/zephyr-main/soc/arm/Kconfig.soc"
osource "/home/bruno/.pico-sdk/zephyr_workspace/zephyr-main/soc/arm/beetle/Kconfig.soc"
osource "/home/bruno/.pico-sdk/zephyr_workspace/zephyr-main/soc/antmicro/myra/Kconfig.soc"
osource "/home/bruno/.pico-sdk/zephyr_workspace/zephyr-main/soc/andestech/Kconfig.soc"
osource "/home/bruno/.pico-sdk/zephyr_workspace/zephyr-main/soc/amd/acp_6_0/Kconfig.soc"
osource "/home/bruno/.pico-sdk/zephyr_workspace/zephyr-main/soc/ambiq/Kconfig.soc"
osource "/home/bruno/.pico-sdk/zephyr_workspace/zephyr-main/soc/allwinner/sun8i_h3/Kconfig.soc"
osource "/home/bruno/.pico-sdk/zephyr_workspace/zephyr-main/soc/alif/ensemble/Kconfig.soc"
osource "/home/bruno/.pico-sdk/zephyr_workspace/zephyr-main/soc/aesc/Kconfig.soc"
osource "/home/bruno/.pico-sdk/zephyr_workspace/zephyr-main/soc/adi/max32/Kconfig.soc"
```
