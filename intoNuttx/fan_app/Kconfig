## runners/pico/pico_wamr/build/Kconfig/soc/Kconfig.sysbuild
```kconfig
# Load Sysbuild SoC Kconfig descriptions.
osource "/home/bruno/.pico-sdk/zephyr_workspace/zephyr-main/soc/xlnx/zynqmp/Kconfig.sysbuild"
osource "/home/bruno/.pico-sdk/zephyr_workspace/zephyr-main/soc/xlnx/zynq7000/Kconfig.sysbuild"
osource "/home/bruno/.pico-sdk/zephyr_workspace/zephyr-main/soc/xlnx/versalnet/Kconfig.sysbuild"
osource "/home/bruno/.pico-sdk/zephyr_workspace/zephyr-main/soc/xlnx/versal2/Kconfig.sysbuild"
osource "/home/bruno/.pico-sdk/zephyr_workspace/zephyr-main/soc/xlnx/versal/Kconfig.sysbuild"
osource "/home/bruno/.pico-sdk/zephyr_workspace/zephyr-main/soc/xen/Kconfig.sysbuild"
osource "/home/bruno/.pico-sdk/zephyr_workspace/zephyr-main/soc/wch/ch32v/Kconfig.sysbuild"
osource "/home/bruno/.pico-sdk/zephyr_workspace/zephyr-main/soc/ti/simplelink/Kconfig.sysbuild"
osource "/home/bruno/.pico-sdk/zephyr_workspace/zephyr-main/soc/ti/mspm0/Kconfig.sysbuild"
osource "/home/bruno/.pico-sdk/zephyr_workspace/zephyr-main/soc/ti/lm3s6965/Kconfig.sysbuild"
osource "/home/bruno/.pico-sdk/zephyr_workspace/zephyr-main/soc/ti/k3/Kconfig.sysbuild"
osource "/home/bruno/.pico-sdk/zephyr_workspace/zephyr-main/soc/telink/tlsr/Kconfig.sysbuild"
osource "/home/bruno/.pico-sdk/zephyr_workspace/zephyr-main/soc/syna/sr100/Kconfig.sysbuild"
osource "/home/bruno/.pico-sdk/zephyr_workspace/zephyr-main/soc/starfive/jh71xx/Kconfig.sysbuild"
osource "/home/bruno/.pico-sdk/zephyr_workspace/zephyr-main/soc/st/stm32/Kconfig.sysbuild"
osource "/home/bruno/.pico-sdk/zephyr_workspace/zephyr-main/soc/snps/qemu_arc/Kconfig.sysbuild"
osource "/home/bruno/.pico-sdk/zephyr_workspace/zephyr-main/soc/snps/nsim/arc_v/Kconfig.sysbuild"
osource "/home/bruno/.pico-sdk/zephyr_workspace/zephyr-main/soc/snps/nsim/arc_classic/Kconfig.sysbuild"
osource "/home/bruno/.pico-sdk/zephyr_workspace/zephyr-main/soc/snps/hsdk4xd/Kconfig.sysbuild"
osource "/home/bruno/.pico-sdk/zephyr_workspace/zephyr-main/soc/snps/hsdk/Kconfig.sysbuild"
osource "/home/bruno/.pico-sdk/zephyr_workspace/zephyr-main/soc/snps/emsk/Kconfig.sysbuild"
osource "/home/bruno/.pico-sdk/zephyr_workspace/zephyr-main/soc/snps/emsdp/Kconfig.sysbuild"
osource "/home/bruno/.pico-sdk/zephyr_workspace/zephyr-main/soc/snps/arc_iot/Kconfig.sysbuild"
osource "/home/bruno/.pico-sdk/zephyr_workspace/zephyr-main/soc/silabs/Kconfig.sysbuild"
osource "/home/bruno/.pico-sdk/zephyr_workspace/zephyr-main/soc/sifli/sf32/Kconfig.sysbuild"
osource "/home/bruno/.pico-sdk/zephyr_workspace/zephyr-main/soc/sifive/sifive_freedom/Kconfig.sysbuild"
osource "/home/bruno/.pico-sdk/zephyr_workspace/zephyr-main/soc/sensry/Kconfig.sysbuild"
osource "/home/bruno/.pico-sdk/zephyr_workspace/zephyr-main/soc/rockchip/Kconfig.sysbuild"
osource "/home/bruno/.pico-sdk/zephyr_workspace/zephyr-main/soc/renode/riscv_virtual/Kconfig.sysbuild"
osource "/home/bruno/.pico-sdk/zephyr_workspace/zephyr-main/soc/renode/cortex_r8_virtual/Kconfig.sysbuild"
osource "/home/bruno/.pico-sdk/zephyr_workspace/zephyr-main/soc/renesas/smartbond/Kconfig.sysbuild"
osource "/home/bruno/.pico-sdk/zephyr_workspace/zephyr-main/soc/renesas/rz/Kconfig.sysbuild"
osource "/home/bruno/.pico-sdk/zephyr_workspace/zephyr-main/soc/renesas/rx/Kconfig.sysbuild"
osource "/home/bruno/.pico-sdk/zephyr_workspace/zephyr-main/soc/renesas/rcar/Kconfig.sysbuild"
osource "/home/bruno/.pico-sdk/zephyr_workspace/zephyr-main/soc/renesas/ra/Kconfig.sysbuild"
osource "/home/bruno/.pico-sdk/zephyr_workspace/zephyr-main/soc/realtek/fingerprint/Kconfig.sysbuild"
osource "/home/bruno/.pico-sdk/zephyr_workspace/zephyr-main/soc/realtek/ec/Kconfig.sysbuild"
osource "/home/bruno/.pico-sdk/zephyr_workspace/zephyr-main/soc/realtek/bee/Kconfig.sysbuild"
osource "/home/bruno/.pico-sdk/zephyr_workspace/zephyr-main/soc/realtek/ameba/Kconfig.sysbuild"
osource "/home/bruno/.pico-sdk/zephyr_workspace/zephyr-main/soc/raspberrypi/rpi_pico/Kconfig.sysbuild"
osource "/home/bruno/.pico-sdk/zephyr_workspace/zephyr-main/soc/quicklogic/eos_s3/Kconfig.sysbuild"
osource "/home/bruno/.pico-sdk/zephyr_workspace/zephyr-main/soc/qemu/virt_riscv/Kconfig.sysbuild"
osource "/home/bruno/.pico-sdk/zephyr_workspace/zephyr-main/soc/qemu/or1k/Kconfig.sysbuild"
osource "/home/bruno/.pico-sdk/zephyr_workspace/zephyr-main/soc/qemu/malta/Kconfig.sysbuild"
osource "/home/bruno/.pico-sdk/zephyr_workspace/zephyr-main/soc/openisa/rv32m1/Kconfig.sysbuild"
osource "/home/bruno/.pico-sdk/zephyr_workspace/zephyr-main/soc/openhwgroup/cva6/Kconfig.sysbuild"
osource "/home/bruno/.pico-sdk/zephyr_workspace/zephyr-main/soc/oct/osd32mp15x/Kconfig.sysbuild"
osource "/home/bruno/.pico-sdk/zephyr_workspace/zephyr-main/soc/nxp/s32/Kconfig.sysbuild"
osource "/home/bruno/.pico-sdk/zephyr_workspace/zephyr-main/soc/nxp/rw/Kconfig.sysbuild"
osource "/home/bruno/.pico-sdk/zephyr_workspace/zephyr-main/soc/nxp/mcx/Kconfig.sysbuild"
osource "/home/bruno/.pico-sdk/zephyr_workspace/zephyr-main/soc/nxp/lpc/Kconfig.sysbuild"
osource "/home/bruno/.pico-sdk/zephyr_workspace/zephyr-main/soc/nxp/layerscape/Kconfig.sysbuild"
osource "/home/bruno/.pico-sdk/zephyr_workspace/zephyr-main/soc/nxp/kinetis/Kconfig.sysbuild"
osource "/home/bruno/.pico-sdk/zephyr_workspace/zephyr-main/soc/nxp/imxrt/Kconfig.sysbuild"
osource "/home/bruno/.pico-sdk/zephyr_workspace/zephyr-main/soc/nxp/imx/Kconfig.sysbuild"
osource "/home/bruno/.pico-sdk/zephyr_workspace/zephyr-main/soc/nuvoton/numicro/Kconfig.sysbuild"
osource "/home/bruno/.pico-sdk/zephyr_workspace/zephyr-main/soc/nuvoton/numaker/Kconfig.sysbuild"
osource "/home/bruno/.pico-sdk/zephyr_workspace/zephyr-main/soc/nuvoton/npcx/Kconfig.sysbuild"
osource "/home/bruno/.pico-sdk/zephyr_workspace/zephyr-main/soc/nuvoton/npcm/Kconfig.sysbuild"
osource "/home/bruno/.pico-sdk/zephyr_workspace/zephyr-main/soc/nordic/Kconfig.sysbuild"
osource "/home/bruno/.pico-sdk/zephyr_workspace/zephyr-main/soc/neorv32/Kconfig.sysbuild"
osource "/home/bruno/.pico-sdk/zephyr_workspace/zephyr-main/soc/native/inf_clock/Kconfig.sysbuild"
osource "/home/bruno/.pico-sdk/zephyr_workspace/zephyr-main/soc/microchip/sam/sama7/Kconfig.sysbuild"
osource "/home/bruno/.pico-sdk/zephyr_workspace/zephyr-main/soc/microchip/sam/sam_d5x_e5x/Kconfig.sysbuild"
osource "/home/bruno/.pico-sdk/zephyr_workspace/zephyr-main/soc/microchip/pic64/Kconfig.sysbuild"
osource "/home/bruno/.pico-sdk/zephyr_workspace/zephyr-main/soc/microchip/pic32c/pic32cz_ca/Kconfig.sysbuild"
osource "/home/bruno/.pico-sdk/zephyr_workspace/zephyr-main/soc/microchip/pic32c/pic32cx_sg/Kconfig.sysbuild"
osource "/home/bruno/.pico-sdk/zephyr_workspace/zephyr-main/soc/microchip/pic32c/pic32cm_pl/Kconfig.sysbuild"
osource "/home/bruno/.pico-sdk/zephyr_workspace/zephyr-main/soc/microchip/pic32c/pic32cm_jh/Kconfig.sysbuild"
osource "/home/bruno/.pico-sdk/zephyr_workspace/zephyr-main/soc/microchip/miv/Kconfig.sysbuild"
osource "/home/bruno/.pico-sdk/zephyr_workspace/zephyr-main/soc/microchip/mec/Kconfig.sysbuild"
osource "/home/bruno/.pico-sdk/zephyr_workspace/zephyr-main/soc/mediatek/mt8xxx/Kconfig.sysbuild"
osource "/home/bruno/.pico-sdk/zephyr_workspace/zephyr-main/soc/lowrisc/opentitan/Kconfig.sysbuild"
osource "/home/bruno/.pico-sdk/zephyr_workspace/zephyr-main/soc/litex/litex_vexriscv/Kconfig.sysbuild"
osource "/home/bruno/.pico-sdk/zephyr_workspace/zephyr-main/soc/ite/ec/Kconfig.sysbuild"
osource "/home/bruno/.pico-sdk/zephyr_workspace/zephyr-main/soc/intel/wildcat_lake/Kconfig.sysbuild"
osource "/home/bruno/.pico-sdk/zephyr_workspace/zephyr-main/soc/intel/raptor_lake/Kconfig.sysbuild"
osource "/home/bruno/.pico-sdk/zephyr_workspace/zephyr-main/soc/intel/panther_lake/Kconfig.sysbuild"
osource "/home/bruno/.pico-sdk/zephyr_workspace/zephyr-main/soc/intel/lakemont/Kconfig.sysbuild"
osource "/home/bruno/.pico-sdk/zephyr_workspace/zephyr-main/soc/intel/intel_socfpga_std/Kconfig.sysbuild"
osource "/home/bruno/.pico-sdk/zephyr_workspace/zephyr-main/soc/intel/intel_socfpga/Kconfig.sysbuild"
osource "/home/bruno/.pico-sdk/zephyr_workspace/zephyr-main/soc/intel/intel_niosv/Kconfig.sysbuild"
osource "/home/bruno/.pico-sdk/zephyr_workspace/zephyr-main/soc/intel/intel_ish/Kconfig.sysbuild"
osource "/home/bruno/.pico-sdk/zephyr_workspace/zephyr-main/soc/intel/intel_adsp/Kconfig.sysbuild"
osource "/home/bruno/.pico-sdk/zephyr_workspace/zephyr-main/soc/intel/elkhart_lake/Kconfig.sysbuild"
osource "/home/bruno/.pico-sdk/zephyr_workspace/zephyr-main/soc/intel/atom/Kconfig.sysbuild"
osource "/home/bruno/.pico-sdk/zephyr_workspace/zephyr-main/soc/intel/apollo_lake/Kconfig.sysbuild"
osource "/home/bruno/.pico-sdk/zephyr_workspace/zephyr-main/soc/intel/alder_lake/Kconfig.sysbuild"
osource "/home/bruno/.pico-sdk/zephyr_workspace/zephyr-main/soc/infineon/psoc4/Kconfig.sysbuild"
osource "/home/bruno/.pico-sdk/zephyr_workspace/zephyr-main/soc/infineon/edge/Kconfig.sysbuild"
osource "/home/bruno/.pico-sdk/zephyr_workspace/zephyr-main/soc/infineon/cat3/Kconfig.sysbuild"
osource "/home/bruno/.pico-sdk/zephyr_workspace/zephyr-main/soc/infineon/cat1c/Kconfig.sysbuild"
osource "/home/bruno/.pico-sdk/zephyr_workspace/zephyr-main/soc/infineon/cat1b/Kconfig.sysbuild"
osource "/home/bruno/.pico-sdk/zephyr_workspace/zephyr-main/soc/infineon/cat1a/Kconfig.sysbuild"
osource "/home/bruno/.pico-sdk/zephyr_workspace/zephyr-main/soc/gd/gd32/Kconfig.sysbuild"
osource "/home/bruno/.pico-sdk/zephyr_workspace/zephyr-main/soc/gaisler/leon3/Kconfig.sysbuild"
osource "/home/bruno/.pico-sdk/zephyr_workspace/zephyr-main/soc/gaisler/gr716a/Kconfig.sysbuild"
osource "/home/bruno/.pico-sdk/zephyr_workspace/zephyr-main/soc/focaltech/Kconfig.sysbuild"
osource "/home/bruno/.pico-sdk/zephyr_workspace/zephyr-main/soc/espressif/Kconfig.sysbuild"
osource "/home/bruno/.pico-sdk/zephyr_workspace/zephyr-main/soc/ene/kb1200/Kconfig.sysbuild"
osource "/home/bruno/.pico-sdk/zephyr_workspace/zephyr-main/soc/ene/kb106x/Kconfig.sysbuild"
osource "/home/bruno/.pico-sdk/zephyr_workspace/zephyr-main/soc/elan/em32f967/Kconfig.sysbuild"
osource "/home/bruno/.pico-sdk/zephyr_workspace/zephyr-main/soc/egis/Kconfig.sysbuild"
osource "/home/bruno/.pico-sdk/zephyr_workspace/zephyr-main/soc/efinix/sapphire/Kconfig.sysbuild"
osource "/home/bruno/.pico-sdk/zephyr_workspace/zephyr-main/soc/cdns/xtensa_sample_controller/Kconfig.sysbuild"
osource "/home/bruno/.pico-sdk/zephyr_workspace/zephyr-main/soc/cdns/swerv/Kconfig.sysbuild"
osource "/home/bruno/.pico-sdk/zephyr_workspace/zephyr-main/soc/cdns/sample_controller32/Kconfig.sysbuild"
osource "/home/bruno/.pico-sdk/zephyr_workspace/zephyr-main/soc/cdns/dc233c/Kconfig.sysbuild"
osource "/home/bruno/.pico-sdk/zephyr_workspace/zephyr-main/soc/brcm/bcmvk/Kconfig.sysbuild"
osource "/home/bruno/.pico-sdk/zephyr_workspace/zephyr-main/soc/brcm/bcm2712/Kconfig.sysbuild"
osource "/home/bruno/.pico-sdk/zephyr_workspace/zephyr-main/soc/brcm/bcm2711/Kconfig.sysbuild"
osource "/home/bruno/.pico-sdk/zephyr_workspace/zephyr-main/soc/blackberry/qnxhv_vm/Kconfig.sysbuild"
osource "/home/bruno/.pico-sdk/zephyr_workspace/zephyr-main/soc/bflb/Kconfig.sysbuild"
osource "/home/bruno/.pico-sdk/zephyr_workspace/zephyr-main/soc/atmel/sam0/Kconfig.sysbuild"
osource "/home/bruno/.pico-sdk/zephyr_workspace/zephyr-main/soc/atmel/sam/Kconfig.sysbuild"
osource "/home/bruno/.pico-sdk/zephyr_workspace/zephyr-main/soc/aspeed/Kconfig.sysbuild"
osource "/home/bruno/.pico-sdk/zephyr_workspace/zephyr-main/soc/arm/Kconfig.sysbuild"
osource "/home/bruno/.pico-sdk/zephyr_workspace/zephyr-main/soc/arm/beetle/Kconfig.sysbuild"
osource "/home/bruno/.pico-sdk/zephyr_workspace/zephyr-main/soc/antmicro/myra/Kconfig.sysbuild"
osource "/home/bruno/.pico-sdk/zephyr_workspace/zephyr-main/soc/andestech/Kconfig.sysbuild"
osource "/home/bruno/.pico-sdk/zephyr_workspace/zephyr-main/soc/amd/acp_6_0/Kconfig.sysbuild"
osource "/home/bruno/.pico-sdk/zephyr_workspace/zephyr-main/soc/ambiq/Kconfig.sysbuild"
osource "/home/bruno/.pico-sdk/zephyr_workspace/zephyr-main/soc/allwinner/sun8i_h3/Kconfig.sysbuild"
osource "/home/bruno/.pico-sdk/zephyr_workspace/zephyr-main/soc/alif/ensemble/Kconfig.sysbuild"
osource "/home/bruno/.pico-sdk/zephyr_workspace/zephyr-main/soc/aesc/Kconfig.sysbuild"
osource "/home/bruno/.pico-sdk/zephyr_workspace/zephyr-main/soc/adi/max32/Kconfig.sysbuild"
```
